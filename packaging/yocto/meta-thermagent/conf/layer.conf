## packaging/yocto/meta-thermagent/conf/layer.conf
```bitbake
# meta-thermagent Yocto/OpenEmbedded layer
BBPATH .= ":${LAYERDIR}"
BBFILES += "${LAYERDIR}/recipes-*/*/*.bb ${LAYERDIR}/recipes-*/*/*.bbappend"

BBFILE_COLLECTIONS += "thermagent"
BBFILE_PATTERN_thermagent = "^${LAYERDIR}/"
BBFILE_PRIORITY_thermagent = "7"

LAYERSERIES_COMPAT_thermagent = "kirkstone langdale mickledore nanbield scarthgap styhead walnascar"
```
